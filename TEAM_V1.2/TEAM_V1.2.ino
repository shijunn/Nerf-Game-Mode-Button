// Author: Tan Shi Jun

// to check serial monitor for ESP32 C6 Mini:
// tools -> USB CDC On Boot: "Enabled"

// current settings:
// board: ESP32C6 Dev Module
// USB CDC on boot: "Enabled"
// CPU frequency: 160MHz (WiFi)
// flash frequency: 80MHz
// flash mode: QIO
// flash size: 4MB
// partition scheme: 4MB with spiffs
// upload speed: 921600

#if !defined( ESP32 )
  #error This code is intended to run on the ESP32 platform! Please check your Tools->Board setting.
#endif

#include <Adafruit_SSD1306.h>
#include <Adafruit_GFX.h>
#include <Adafruit_NeoPixel.h>
#include <Preferences.h> // https://randomnerdtutorials.com/esp32-save-data-permanently-preferences/
#include <esp_now.h>  // https://randomnerdtutorials.com/esp-now-one-to-many-esp32-esp8266/
#include <WiFi.h>
#include <esp_wifi.h>
#include <string.h>

#define NUM_PIXELS 32
#define SCREEN_WIDTH 128
#define SCREEN_HEIGHT 64
#define OLED_RESET -1
#define SCREEN_ADDRESS 0x3c
#define devdebug
#define RW_MODE false
#define RO_MODE true
#define SENDCOOLDOWN 5000
#define debouncedelay 20

void OnDataSent(const uint8_t *mac_addr, esp_now_send_status_t status);
void OnDataRecv(const uint8_t *mac, const uint8_t *incomingData, int len);
void oledDisplayCenter(String text);
void oledDisplayInt(int number);
void oledDisplayCountdown(int seconds);
void oledDisplayStrInt(int number, String text);
void updateddisplay(void);
void resetvariables(void);
void captureTheFlag(void);
void kingOfTheHill(void);
void domination(void);
void clickerDomination(void);
void chessClock(void);
void colorWipe(uint32_t c, uint8_t wait);
void sendscoretimeendgame(void);

/*
why is enum used 
https://www.reddit.com/r/learnprogramming/comments/yk8d84/comment/iurxecv/?utm_source=share&utm_medium=web3x&utm_name=web3xcss&utm_term=1&utm_content=share_button
*/
enum gamemodes {
  CAPTURE_THE_FLAG = 0,  // enum automatically adds the next integer
  DOMINATION,
  KING_OF_THE_HILL,
  CLICKER_DOMINATION,
  CHESS_CLOCK,
  SETTING,
  BOARD_NUMBER,
  NUM_MODES              // if game modes are added or removed down the line, enum will automatically change the integer of NUM_MODES
};

// variables for ESP NOW transmission
typedef struct game_struct
{
  int score = 0;
  unsigned long gamemodetime = 0;
  bool endgame = false;
  unsigned long checktime;
  unsigned long newTime;
  // unsigned long prevTime;
  // unsigned long totalTime;
  unsigned long testtime = 0;
  unsigned long recordedTime = 0;
  int modenum;
  bool confirm;
  unsigned long countdowntime;
  int id = 1;
  int togglescreen;
  bool middlelongpressed;
  bool goback;
  bool button = false;
} game_struct;

game_struct gamedata;
game_struct incominggamedata; // for team or host board

// create variables to assign values from the recv callback function to update and store new values
int incomingmodenum;
int incomingtogglescreen;
int lastincomingmodenum = 0;
bool incomingconfirm = false;
unsigned long incominggamemodetime;
unsigned long incomingcountdowntime;
bool incomingmiddlelongpressed;
bool incominggoback;
bool incomingbutton = false;


// ESP32 pin definition
const int neopixelpin = 19;
const int otaButton = 4;  // OTA button
const int extButton = 5;     // external button


// declare variables
int reading = 0;
int avgReading = 0;
int lastmenu = -1;
int menu = CAPTURE_THE_FLAG;     // menu = 0
int laststate = HIGH;
int buttonstate;
int defaultbuttonstate = HIGH;
bool startedrecording = false;
bool pressed = false;
bool storedPrev = false;
bool sentbefore = false; // for cooldown
bool firstconfirm = true;
unsigned long prevTime;
unsigned long totalTime;
unsigned long startGameTime;
unsigned long startPressTime;
unsigned long lastdebouncetime = 0;
unsigned long timesetting = 0;
unsigned long longpress = 0;
unsigned long timesent = 0;

// define variables
Adafruit_SSD1306 display(SCREEN_WIDTH, SCREEN_HEIGHT, &Wire, OLED_RESET);  //declaration for SSD1306 display connected using I2C
Adafruit_NeoPixel pixels(NUM_PIXELS, neopixelpin, NEO_GRB + NEO_KHZ800); // declaration for neopixel
Preferences preferences; // to store in ESP32 NVS

// receiver MAC address
uint8_t broadcastAddressHost[] = {0xe4, 0xb3, 0x23, 0x94, 0x3b, 0x28};
esp_now_peer_info_t peerInfo; // https://randomnerdtutorials.com/esp-now-many-to-one-esp32/#more-96216

// IFB boot up logo
const unsigned char ifb_logo [] PROGMEM =
{
	0xff, 0xff, 0xff, 0xff, 0xff, 0xff, 0xff, 0xff, 0xff, 0xff, 0xff, 0xff, 0xff, 0xff, 0xff, 0xff, 
	0xff, 0xff, 0xff, 0xff, 0xff, 0xff, 0xff, 0xff, 0xff, 0xff, 0xff, 0xff, 0xff, 0xff, 0xff, 0xff, 
	0xff, 0xff, 0xff, 0xff, 0xff, 0xff, 0xff, 0xff, 0xff, 0xff, 0xff, 0xff, 0xff, 0xff, 0xff, 0xff, 
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	0xff, 0xff, 0xff, 0xff, 0xff, 0xff, 0xff, 0xff, 0xff, 0xff, 0xff, 0xff, 0xff, 0xff, 0xff, 0xff
};

void setup()
{
  Serial.begin(115200);
  delay(50);
  Wire.begin(6, 7);
  WiFi.mode(WIFI_STA);

  // configure pins
  pinMode(otaButton, INPUT);
  pinMode(extButton, INPUT);

  // init ESP-NOW
  if (esp_now_init() != ESP_OK) {
    Serial.println("Error initializing ESP-NOW");
    return;
  }
  delay(50);

  // once ESPNow is successfully init, register for send CB to get the status of trasnmitted packet
  esp_now_register_send_cb(OnDataSent);
  
  // register host as a peer
  peerInfo.channel = 0;  
  peerInfo.encrypt = false;
  memcpy(peerInfo.peer_addr, broadcastAddressHost, 6);
  if (esp_now_add_peer(&peerInfo) != ESP_OK)
  {
    Serial.println("Failed to add peer");
    return;
  }

  // check if OLED display is connected
  if (!display.begin(SSD1306_SWITCHCAPVCC, SCREEN_ADDRESS))
  {
    Serial.println(F("SSD1306 allocation failed"));
    delay(50);
    ESP.restart();
  }
  delay(50);
  // init OLED display and show logo
  display.clearDisplay();
  display.drawBitmap(0, 0, ifb_logo, 128, 64, 1);
  display.display();
  display.setTextSize(2);
  display.setTextColor(SSD1306_WHITE);

  // init neopixels
  pixels.begin();
  pixels.clear();
  pixels.show();
  pixels.setBrightness(30);

  // register recv CB
  esp_now_register_recv_cb(esp_now_recv_cb_t(OnDataRecv));

  sendscoretimeendgame();
  delay(1000);
}

void loop()
{
  if (digitalRead(otaButton) == LOW) // change to red team
  {
    gamedata.id = 2;
    sendcooldown();
  }
  updatedisplay();
  while (incomingconfirm)
  { // only receives confirm flag when host long pressed on a game mode not setting
    if (firstconfirm)
    {
      colorWipe(pixels.Color(255, 255, 255), 5);
      pixels.clear();
      pixels.show();
      firstconfirm = false;
    }
    switch (incomingmodenum)
    {
      case CAPTURE_THE_FLAG:
        captureTheFlag();
        break;

      case DOMINATION:
        domination();
        break;

      case KING_OF_THE_HILL:
        kingOfTheHill();
        break;

      case CLICKER_DOMINATION:
        clickerDomination();
        break;

      case CHESS_CLOCK:
        chessClock();
        break;

      case SETTING:
        //while (incomingconfirm == true){
          if (incomingtogglescreen == 0)
          {
            oledDisplayStrInt("Mins: ", incominggamemodetime / 60000);
          }
          else if (incomingtogglescreen == 1)
          {
            oledDisplayStrInt("Sec: ", incomingcountdowntime / 1000);
          }
        //}
        break;

      case BOARD_NUMBER:
        sendscoretimeendgame();
        break;

      default:
        Serial.printf("error! modenum received: %d", incomingmodenum);
        break;
    }
    // replace these 3 lines with resetvariables()
    gamedata.score = 0; // reset score on host board and team board
    gamedata.endgame = false; // reset endgame flag on team board and send it to host board
    sentbefore = false;
    sendscoretimeendgame();
  }
  firstconfirm = true;
  pixels.clear();
  pixels.show();
}